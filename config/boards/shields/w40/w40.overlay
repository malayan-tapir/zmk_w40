#include "w40.dtsi"

/ {
    chosen {
        zmk,kscan = &kscan0;
    };

    kscan0: kscan_0 {
        compatible = "zmk,kscan-gpio-charlieplex";
        wakeup-source;

        interrupt-gpios = <&xiao_d 10 (GPIO_ACTIVE_HIGH | GPIO_PULL_DOWN)>;
        gpios = <&xiao_d 2 GPIO_ACTIVE_HIGH>,
                <&xiao_d 3 GPIO_ACTIVE_HIGH>,
                <&xiao_d 4 GPIO_ACTIVE_HIGH>,
                <&xiao_d 5 GPIO_ACTIVE_HIGH>,
                <&xiao_d 6 GPIO_ACTIVE_HIGH>,
                <&xiao_d 7 GPIO_ACTIVE_HIGH>,
                <&xiao_d 8 GPIO_ACTIVE_HIGH>,
                <&xiao_d 9 GPIO_ACTIVE_HIGH>;
    };
};

&xiao_serial {
    status = "disabled";
};
